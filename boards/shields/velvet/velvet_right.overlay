#include "pkkblab.dtsi" // 

&default_transform { // The matrix transform for this board is 5 columns over because the left half is 5 columns wide according to the matrix.
    col-offset = <5>;
};

&kscan0 {
    col-gpios
        = <&pro_micro 15 GPIO_ACTIVE_HIGH> // COL5
        , <&pro_micro 14 GPIO_ACTIVE_HIGH> // COL6
        , <&pro_micro 20 GPIO_ACTIVE_HIGH> // COL7
        , <&pro_micro 19 GPIO_ACTIVE_HIGH> // COL8
        , <&pro_micro 18 GPIO_ACTIVE_HIGH> // COL9
        ;
};
